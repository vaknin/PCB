## boards/capture-clip/firmware/main/Kconfig.projbuild
```kconfig
menu "capture-clip simulation"

config CLIP_SIM_FAIL_TRIAL
    bool "A firmware that fails its own check after an update (QEMU rollback scenario)"
    depends on BOARD_TARGET_QEMU
    default n
    help
        Only for the "bad update is rolled back" scenario (sim/run.py): this build, installed
        as an update, fails update_trial() and must be rolled back. Never in a real build.

endmenu
```

## firmware/components/board/Kconfig
```kconfig
menu "Board (pcbgen, D-025)"

choice BOARD_TARGET
    prompt "What this build runs on"
    default BOARD_TARGET_REAL
    help
        REAL is the only build that may be flashed to a board (devctl refuses the others).
        QEMU and WOKWI swap in stand-ins for what the simulator lacks: injected audio,
        a loop instead of deep sleep, and (QEMU) a UART0 console and Ethernet.

    config BOARD_TARGET_REAL
        bool "Real hardware"
    config BOARD_TARGET_QEMU
        bool "Espressif QEMU (no GPIO, I2C, I2S, USB, Wi-Fi or deep sleep)"
    config BOARD_TARGET_WOKWI
        bool "Wokwi (no I2S or deep sleep)"
endchoice

config BOARD_TARGET_NAME
    string
    default "real" if BOARD_TARGET_REAL
    default "qemu" if BOARD_TARGET_QEMU
    default "wokwi" if BOARD_TARGET_WOKWI

endmenu
```

## firmware/spikes/codec/real/main/Kconfig.projbuild
```kconfig
menu "Codec spike (real hardware)"
    config SPIKE_EMBED_SPEECH
        bool "Embed ../out/speech.wav (the owner's voice; never leave it on a board)"
        default n
endmenu
```

## firmware/spikes/codec/real/sdkconfig.defaults
```kconfig
CONFIG_IDF_TARGET="esp32s3"
CONFIG_ESPTOOLPY_FLASHSIZE_16MB=y
CONFIG_PARTITION_TABLE_CUSTOM=y
CONFIG_PARTITION_TABLE_CUSTOM_FILENAME="../partitions.csv"
CONFIG_SPIRAM=y
CONFIG_SPIRAM_MODE_OCT=y
CONFIG_SPIRAM_MEMTEST=n
CONFIG_ESP_CONSOLE_USB_SERIAL_JTAG=y
CONFIG_ESP_DEFAULT_CPU_FREQ_MHZ_240=y
CONFIG_PM_ENABLE=y
CONFIG_ESP_TASK_WDT_EN=n
CONFIG_ESP_WIFI_NVS_ENABLED=n
```

## firmware/spikes/codec/sdkconfig.defaults
```kconfig
CONFIG_IDF_TARGET="esp32s3"
CONFIG_ESPTOOLPY_FLASHSIZE_16MB=y
CONFIG_PARTITION_TABLE_CUSTOM=y
CONFIG_PARTITION_TABLE_CUSTOM_FILENAME="partitions.csv"
CONFIG_SPIRAM=y
CONFIG_SPIRAM_MODE_OCT=y
CONFIG_SPIRAM_MEMTEST=n
CONFIG_ESP_CONSOLE_UART_DEFAULT=y
CONFIG_BOOTLOADER_WDT_ENABLE=n
CONFIG_ESP_DEFAULT_CPU_FREQ_MHZ_240=y
CONFIG_ESP_TASK_WDT_EN=n
```
